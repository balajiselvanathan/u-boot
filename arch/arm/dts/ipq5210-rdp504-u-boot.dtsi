// SPDX-License-Identifier: GPL-2.0
/*
 * IPQ5210 RDP504 board device tree source
 *
 * Copyright (c) 2026 The Linux Foundation. All rights reserved.
 */

/ {
	reserved-memory {
		/delete-node/ bootloader@87800000;
	};
};
